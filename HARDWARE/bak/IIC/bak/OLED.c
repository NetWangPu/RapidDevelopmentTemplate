/*OLED底层驱动
*@采用列行式，分辨率为128*64
*存放格式如下.
*[0]0 1 2 3 ... 127	
*[1]0 1 2 3 ... 127	
*[2]0 1 2 3 ... 127	
*[3]0 1 2 3 ... 127	
*[4]0 1 2 3 ... 127	
*[5]0 1 2 3 ... 127	
*[6]0 1 2 3 ... 127	
*[7]0 1 2 3 ... 127 
*/
#include "sys.h"
#include "stdlib.h"
#include "OLED.h"


#define XLevelL		0x00
#define XLevelH		0x10
#define XLevel		((XLevelH&0x0F)*16+XLevelL)
#define Max_Column	128
#define Max_Row		  64
#define	Brightness	0xCF 


#define X_WIDTH 128
#define Y_WIDTH 64

/*OLED屏地址*/
#define OLED_ADDRESS 0x78

/*设置哪一个使用I2C*/
#define I2Cx I2C1


/*引脚初始化*/
void OLED_I2C_Init(void)
{
	GPIO_InitTypeDef  GPIO_InitStructure;
	I2C_InitTypeDef  I2C_InitStructure;
	RCC_APB1PeriphClockCmd(RCC_APB1Periph_I2C1,ENABLE);	//使能I2C1时钟
	RCC_APB2PeriphClockCmd(RCC_APB2Periph_GPIOB,ENABLE);//使能GPIOB时钟
 
	/*STM32F103芯片的硬件I2C: PB6 -- SCL; PB7 -- SDA */
	GPIO_InitStructure.GPIO_Pin =  GPIO_Pin_6 | GPIO_Pin_7;
	GPIO_InitStructure.GPIO_Speed = GPIO_Speed_50MHz;
	GPIO_InitStructure.GPIO_Mode = GPIO_Mode_AF_OD;		//设置输出模式为开漏输出，需接上拉电阻
	GPIO_Init(GPIOB, &GPIO_InitStructure);
	
	I2C_DeInit(I2Cx);	//将外设I2C寄存器重设为缺省值
	I2C_InitStructure.I2C_Mode = I2C_Mode_I2C;			//工作模式
	I2C_InitStructure.I2C_DutyCycle = I2C_DutyCycle_2;	//时钟占空比，Tlow/Thigh = 2
	I2C_InitStructure.I2C_OwnAddress1 = 0x88;	//主机的I2C地址,用不到则随便写，无影响
	I2C_InitStructure.I2C_Ack = I2C_Ack_Enable;	//使能应答位
	I2C_InitStructure.I2C_AcknowledgedAddress = I2C_AcknowledgedAddress_7bit;//设置地址长度7位
	I2C_InitStructure.I2C_ClockSpeed = 400000;	//I2C传输速度，400K，根据自己所用芯片手册查看支持的速度。	
	I2C_Init(I2Cx, &I2C_InitStructure);

	I2C_Cmd(I2Cx, ENABLE);
}

void I2C_WriteByte(uint8_t addr,uint8_t data)
{
	
	while( I2C_GetFlagStatus(I2Cx, I2C_FLAG_BUSY));
	
	//发送起始信号
	I2C_GenerateSTART(I2Cx, ENABLE);
	//检测EV5事件
	while( I2C_CheckEvent(I2Cx,I2C_EVENT_MASTER_MODE_SELECT)==ERROR);
	//发送设备写地址
	I2C_Send7bitAddress(I2Cx, OLED_ADDRESS, I2C_Direction_Transmitter);
	//检测EV6事件
	while( I2C_CheckEvent(I2Cx,I2C_EVENT_MASTER_TRANSMITTER_MODE_SELECTED)==ERROR);
	
	//发送要操作设备内部的地址
	I2C_SendData(I2Cx, addr);
	//检测EV8_2事件
	while (!I2C_CheckEvent(I2Cx, I2C_EVENT_MASTER_BYTE_TRANSMITTED));
	
	I2C_SendData(I2Cx, data);//发送数据
	while (!I2C_CheckEvent(I2Cx, I2C_EVENT_MASTER_BYTE_TRANSMITTED));

	//发送停止信号
	I2C_GenerateSTOP(I2Cx, ENABLE);
}

//======================================
const u8 F6x8[] =
{
    0x00, 0x00, 0x00, 0x00, 0x00, 0x00 ,   // sp
    0x00, 0x00, 0x00, 0x2f, 0x00, 0x00 ,   // !
    0x00, 0x00, 0x07, 0x00, 0x07, 0x00 ,   // "
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    0x14, 0x14, 0x14, 0x14, 0x14, 0x14     // horiz lines
};

const u8 F16x16_Idx[] = 
{
	"有火焰烟雾异校准电压调时钟°温湿度正常"
};

const u8 F16x16[] = 
{

0x04,0x04,0x04,0x84,0xE4,0x3C,0x27,0x24,0x24,0x24,0x24,0xE4,0x04,0x04,0x04,0x00,
0x04,0x02,0x01,0x00,0xFF,0x09,0x09,0x09,0x09,0x49,0x89,0x7F,0x00,0x00,0x00,0x00,//有0

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0x00,0x00,0x3E,0x02,0x02,0x02,0x02,0xFF,0x02,0x02,0x12,0x22,0x1E,0x00,0x00,0x00,//常3
};
//======================================================
// 128X64I液晶底层驱动[8X16]字体库
// 设计者: powerint
// 描  述: [8X16]西文字符的字模数据 (纵向取模,字节倒序)
// !"#$%&'()*+,-./0123456789:;<=>?@ABCDEFGHIJKLMNOPQRSTUVWXYZ[\]^_`abcdefghijklmnopqrstuvwxyz{|}~
//======================================================
const u8 F8X16[]=
{
	0x00,0x00,0x00,0x00,0x00,0x00,0x00,0x00,0x00,0x00,0x00,0x00,0x00,0x00,0x00,0x00,// 0
	0x00,0x00,0x00,0xF8,0x00,0x00,0x00,0x00,0x00,0x00,0x00,0x33,0x30,0x00,0x00,0x00,//!1
	0x00,0x10,0x0C,0x06,0x10,0x0C,0x06,0x00,0x00,0x00,0x00,0x00,0x00,0x00,0x00,0x00,//"2
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	0x00,0x06,0x01,0x01,0x02,0x02,0x04,0x04,0x00,0x00,0x00,0x00,0x00,0x00,0x00,0x00,//~94

};
/* 生成实心菱形图标的16*16点阵*/
const u8 nonside[] =
{
	0x00,0x00,0x80,0xC0,0xE0,0xF0,0xF8,0xFC,0xF8,0xF0,0xE0,0xC0,0x80,0x00,0x00,0x00,
	0x00,0x00,0x00,0x01,0x03,0x07,0x0F,0x1F,0x0F,0x07,0x03,0x01,0x00,0x00,0x00,0x00,//◆0,
};


//
 
/**
  * @brief  OLED写命令
  * @param  Command 要写入的命令
  * @retval 无
  */
void LCD_WrCmd(u8 cmd)
{
	I2C_WriteByte(0x00, cmd);
}
 
/**
  * @brief  OLED写数据
  * @param  Data 要写入的数据
  * @retval 无
*/
void LCD_WrDat(u8 data)
{
	I2C_WriteByte(0x40, data);
}


/*设置起始地址
*Y轴是按8格递进的，y轴0~63，只能按8格的倍数显示，
*因为列行式只能按8个字节进行
*/
void LCD_Set_Pos(u8 x, u8 y)
{ 
  LCD_WrCmd(0xb0+(y>>3));
  LCD_WrCmd(((x&0xf0)>>4)|0x10);
  LCD_WrCmd((x&0x0f)|0x01); 
} 
void LCD_Fill(u8 bmp_data)
{
	u8 y,x;
	
	for(y=0;y<8;y++)
	{
		LCD_WrCmd(0xb0+y);
		LCD_WrCmd(0x01);
		LCD_WrCmd(0x10);
		for(x=0;x<X_WIDTH;x++)
			LCD_WrDat(bmp_data);
	}
}
void LCD_CLS(void)
{
	u8 y,x;	
	for(y=0;y<8;y++)
	{
		LCD_WrCmd(0xb0+y);
		LCD_WrCmd(0x01);
		LCD_WrCmd(0x10); 
		for(x=0;x<X_WIDTH;x++)
			LCD_WrDat(0);
	}
}
//清除一行0-63
void LCD_CLS_y(char y)
{
	u8 x;	
	
	LCD_WrCmd(0xb0+(y>>3));
	LCD_WrCmd(0x01);
	LCD_WrCmd(0x10); 
	for(x=0;x<X_WIDTH;x++)
	{
		LCD_WrDat(0);
	}
	
}

//清除一行上的一块区域y=0-63
void LCD_CLS_line_area(u8 start_x,u8 start_y,u8 width)
{
	u8 x;	
	
	LCD_WrCmd(0xb0+(start_y>>3));
	LCD_WrCmd(0x01);
	LCD_WrCmd(0x10); 
	for(x=start_x;x<width;x++)
	{
		LCD_WrDat(0);
	}
	
}


void LCD_DLY_ms(u16 ms)
{                         
  u16 a;
  while(ms)
  {
    a=1335;
    while(a--);
    ms--;
  }
  return;
}
//==============================================================
//函数名： void LCD_PutPixel(u8 x,u8 y)
//功能描述：绘制一个点（x,y）
//参数：真实坐标值(x,y),x的范围0～127，y的范围0～64
//返回：无
//==============================================================
void LCD_PutPixel(u8 x,u8 y)
{
	u8 data1;  //data1当前点的数据 
	 
    //LCD_Set_Pos(x,y); 
	data1 = 0x01<<(y%8); 	
	LCD_WrCmd(0xb0+(y>>3));
	LCD_WrCmd(((x&0xf0)>>4)|0x10);
	LCD_WrCmd((x&0x0f)|0x00);
	LCD_WrDat(data1); 	 	
}
//==============================================================
//函数名： void LCD_Put_Column(u8 x,u8 y,u8 data)
//功能描述：操作一列显示，一列全显示0XFF,清除一列0X00;
//参数：真实坐标值(x,y),x的范围0～127，y的范围0～64
//返回：无
//==============================================================
void LCD_Put_Column(u8 x,u8 y,u8 data)
{	
	LCD_WrCmd(0xb0+(y>>3));
	LCD_WrCmd(((x&0xf0)>>4)|0x10);
	LCD_WrCmd((x&0x0f)|0x00);
	LCD_WrDat(data); 	 	
}


//==============================================================
//函数名： void LCD_Rectangle(u8 x1,u8 y1,
//                   u8 x2,u8 y2,u8 color,u8 gif)
//功能描述：绘制一个实心矩形
//参数：左上角坐标（x1,y1）,右下角坐标（x2，y2）
//      其中x1、x2的范围0～127，y1，y2的范围0～63，即真实坐标值
//返回：无
//==============================================================
void LCD_Rectangle(u8 x1,u8 y1,u8 x2,u8 y2,u8 gif)
{
	u8 n; 
		
	LCD_Set_Pos(x1,y1>>3);
	for(n=x1;n<=x2;n++)
	{
		LCD_WrDat(0x01<<(y1%8)); 			
		if(gif == 1) 	LCD_DLY_ms(50);
	}  
	LCD_Set_Pos(x1,y2>>3);
  for(n=x1;n<=x2;n++)
	{
		LCD_WrDat(0x01<<(y2%8)); 			
		if(gif == 1) 	LCD_DLY_ms(5);
	}
	
}  
//==============================================================
//函数名：LCD_P6x8Str(u8 x,u8 y,u8 *p)
//功能描述：写入一组标准ASCII字符串
//参数：显示的位置（x,y），y为页范围0～7，要显示的字符串
//返回：无
//==============================================================  
void LCD_P6x8Str(u8 x,u8 y,u8 *ch,const u8 *F6x8)
{
	u8 c=0,i=0,j=0;

	while (*(ch+j)!='\0')
	{    
		c =*(ch+j)-32;
		if(x>126)
		{
			x=0;
			y++;
		}
		LCD_Set_Pos(x,y);    
		for(i=0;i<6;i++) 
		{
			LCD_WrDat(*(F6x8+c*6+i));
		}
		x+=6;
		j++;
	}
}
//==============================================================
//函数名：LCD_P8x16Str(u8 x,u8 y,u8 *p)
//功能描述：写入一组标准ASCII字符串
//参数：显示的位置（x,y），y为页范围0～63，要显示的字符串
//返回：无
//==============================================================  
void LCD_P8x16Str(u8 x,u8 y,u8 *ch,const u8 *F8x16)
{
  u8 c=0,i=0,j=0;
        
  while (*(ch+j)!='\0')
  {    
    c =*(ch+j)-32;
    if(x>120)
	{	
		x=0;
		y++;
	}
    LCD_Set_Pos(x,y); 
  	for(i=0;i<8;i++) 
  	{
  	  	LCD_WrDat(*(F8x16+c*16+i));
  	}
  	LCD_Set_Pos(x,y+8);    
  	for(i=0;i<8;i++)  
  	{
  	  	LCD_WrDat(*(F8x16+c*16+i+8));  
  	}
  	x+=8;
  	j++;
  }
}
//输出汉字字符串
void LCD_P14x16Str(u8 x,u8 y,u8 ch[],const u8 *F14x16_Idx,const u8 *F14x16)
{
	u8 wm=0,ii = 0;
	u16 adder=1; 
	
	while(ch[ii] != '\0')
	{
	  	wm = 0;
	  	adder = 1;
	  	while(*(F14x16_Idx+wm) > 127)
	  	{
	  		if(*(F14x16_Idx+wm) == ch[ii])
	  		{
	  			if(*(F14x16_Idx+wm+1) == ch[ii + 1])
	  			{
	  				adder = wm * 14;
	  				break;
	  			}
	  		}
	  		wm += 2;			
	  	}
	  	if(x>118)
		{
			x=0;
			y++;
		}
	  	LCD_Set_Pos(x , y); 
	  	if(adder != 1)// 显示汉字					
	  	{
	  		LCD_Set_Pos(x , y);
	  		for(wm = 0;wm < 14;wm++)               
	  		{
	  			LCD_WrDat(*(F14x16+adder));	
	  			adder += 1;
	  		}      
	  		LCD_Set_Pos(x,y + 1); 
	  		for(wm = 0;wm < 14;wm++)          
	  		{
	  			LCD_WrDat(*(F14x16+adder));
	  			adder += 1;
	  		}   		
	  	}
	  	else			  //显示空白字符			
	  	{
	  		ii += 1;
	      	LCD_Set_Pos(x,y);
	  		for(wm = 0;wm < 16;wm++)
	  		{
	  			LCD_WrDat(0);
	  		}
	  		LCD_Set_Pos(x,y + 1);
	  		for(wm = 0;wm < 16;wm++)
	  		{   		
	  			LCD_WrDat(0);	
	  		}
	  	}
	  	x += 14;
	  	ii += 2;
	}
}
//输出汉字字符串
void LCD_P16x16Str(u8 x,u8 y,u8 *ch,const u8 *F16x16_Idx,const u8 *F16x16)
{
	u8 wm=0,ii = 0;
	u16 adder=1; 
	
	while(*(ch+ii) != '\0')
	{
  	wm = 0;
  	adder = 1;
  	while(*(F16x16_Idx+wm) > 127)
  	{
  		if(*(F16x16_Idx+wm) == *(ch+ii))
  		{
  			if(*(F16x16_Idx+wm + 1) == *(ch+ii + 1))
  			{
  				adder = wm * 16;
  				break;
  			}
  		}
  		wm += 2;			
  	}
  	if(x>118){x=0;y++;}
  	LCD_Set_Pos(x , y); 
  	if(adder != 1)// 显示汉字					
  	{
  		LCD_Set_Pos(x , y);
  		for(wm = 0;wm < 16;wm++)               
  		{
  			LCD_WrDat(*(F16x16+adder));	
  			adder += 1;
  		}      
  		LCD_Set_Pos(x,y + 8); 
  		for(wm = 0;wm < 16;wm++)          
  		{
  			LCD_WrDat(*(F16x16+adder));
  			adder += 1;
  		}   		
  	}
  	else			  //显示空白字符			
  	{
  		ii += 1;
      	LCD_Set_Pos(x,y);
  		for(wm = 0;wm < 16;wm++)
  		{
  			LCD_WrDat(0);
  		}
  		LCD_Set_Pos(x,y + 1);
  		for(wm = 0;wm < 16;wm++)
  		{   		
  			LCD_WrDat(0);	
  		}
  	}
  	x += 16;
  	ii += 2;
	}
}


/*输出汉字和字符混合字符串
*Y轴是按8格递进的，y轴0~63，只能按8格的倍数显示，
*因为列行式只能按8个字节进行
*
*/

void LCD_Print(u8 x, u8 y, u8 *ch,u8 char_size, u8 ascii_size)
{
	u8 ch2[3];
	u8 ii=0;        
	while(*(ch+ii) != '\0')
	{
		if(*(ch+ii) > 127)//大于127为中文，小于等于127为ASCII
		{
			ch2[0] = *(ch+ii);
	 		ch2[1] = *(ch+ii+1);
			ch2[2] = '\0';			//汉字为两个字节
			LCD_P16x16Str(x , y, ch2,F16x16_Idx,F16x16);	//显示汉字
			x += 16;
			ii += 2;
		}
		else
		{
			ch2[0] = *(ch+ii);	
			ch2[1] = '\0';			//字母占一个字节
			if(TYPE8X16==ascii_size)
			{
				LCD_P8x16Str(x , y ,ch2,F8X16);	//显示字母
				x += 8;
			}
			else if(TYPE6X8==ascii_size)
			{
				LCD_P6x8Str(x , y ,ch2,F6x8);	//显示字母
				x += 6;
			}
			
			ii+= 1;
		}
	}
} 

//==============================================================
//函数名： void Draw_BMP(u8 x,u8 y)
//功能描述：显示BMP图片128×64
//参数：起始点坐标(x,y),x的范围0～127，y为页的范围0～63
//返回：无
//==============================================================
void Draw_BMP(u8 x,u8 y,const u8 *bmp)
{ 	
	u8 wm=0;
	u8 adder=0;
  
  	LCD_Set_Pos(x , y);
	for(wm = 0;wm < 16;wm++)               
	{
		LCD_WrDat(*(bmp+adder));	
		adder += 1;
	}      
	LCD_Set_Pos(x,y + 8); 
	for(wm = 0;wm < 16;wm++)          
	{
		LCD_WrDat(*(bmp+adder));
		adder += 1;
	}
 /* u32 ii=0;
  u8 x,y;
  
  if(y1%8==0) y=y1/8;      
  else y=y1/8+1;
	for(y=y0;y<=y1;y++)
	{
		LCD_Set_Pos(x0,y);				
    for(x=x0;x<x1;x++)
	    {      
	    	LCD_WrDat(bmp[ii++]);	    	
	    }
	}	*/
}


/**
  * @brief  OLED初始化
  * @param  无
  * @retval 无
  */
void OLED_Init(void)
{
	
	OLED_I2C_Init();			//端口初始化
	
	LCD_WrCmd(0xAE);	//关闭显示
	
	LCD_WrCmd(0xD5);	//设置显示时钟分频比/振荡器频率
	LCD_WrCmd(0x80);
	
	LCD_WrCmd(0xA8);	//设置多路复用率
	LCD_WrCmd(0x3F);
	
	LCD_WrCmd(0xD3);	//设置显示偏移
	LCD_WrCmd(0x00);
	
	LCD_WrCmd(0x40);	//设置显示开始行
	
	LCD_WrCmd(0xA1);	//设置左右方向，0xA1正常 0xA0左右反置
	
	LCD_WrCmd(0xC8);	//设置上下方向，0xC8正常 0xC0上下反置

	LCD_WrCmd(0xDA);	//设置COM引脚硬件配置
	LCD_WrCmd(0x12);
	
	LCD_WrCmd(0x81);	//设置对比度控制
	LCD_WrCmd(0xCF);

	LCD_WrCmd(0xD9);	//设置预充电周期
	LCD_WrCmd(0xF1);

	LCD_WrCmd(0xDB);	//设置VCOMH取消选择级别
	LCD_WrCmd(0x30);

	LCD_WrCmd(0xA4);	//设置整个显示打开/关闭

	LCD_WrCmd(0xA6);	//设置正常/倒转显示

	LCD_WrCmd(0x8D);	//设置充电泵
	LCD_WrCmd(0x14);

	LCD_WrCmd(0xAF);	//开启显示
		
	LCD_Fill(0);				//OLED清屏
	LCD_Set_Pos(0,0);	
}
/*
float AHT_Range[2] = {0};//湿度上下限
short DS_Range[2] = {0};//温度上下限
float PH_Range[2] = {0};//PH上下限
u16   O2_Range[2] = {0};//O2上下限


	u8 str[16] = {0};
 	u16 t;  
	u16 len;	
	u16 times=0;
	float Hum=0,AHT_Temp=0;//获取AHT10数据
	short DS_Temp = 0;//获取DS18B20数据
	u16 ADC0_Num = 0; //ADC0的数值
	u16 ADC1_Num = 0;//ADC1的数据
	float ADC1_Voli = 0.0;//ADC1口的电压值
	float PH = 0.0;//PH值
	u16 O2 = 0.0;//氧气值



*/
